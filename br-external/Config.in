## br-external/Config.in
```kconfig
source "$BR2_EXTERNAL_BR2RAUC_PATH/package/libndef/Config.in"
source "$BR2_EXTERNAL_BR2RAUC_PATH/package/libntag21x/Config.in"
source "$BR2_EXTERNAL_BR2RAUC_PATH/package/librespot/Config.in"
source "$BR2_EXTERNAL_BR2RAUC_PATH/package/pp3-api/Config.in"
source "$BR2_EXTERNAL_BR2RAUC_PATH/package/pp3-core/Config.in"
source "$BR2_EXTERNAL_BR2RAUC_PATH/package/pp3-web-ui/Config.in"
```

## br-external/package/pp3-api/Config.in
```kconfig
config BR2_PACKAGE_PP3_API
	bool "pp3-api"
	select BR2_PACKAGE_PYTHON3
	select BR2_PACKAGE_PYTHON3_SSL
	select BR2_PACKAGE_PYTHON_FASTAPI
	select BR2_PACKAGE_PYTHON_UVICORN
```

## br-external/package/pp3-core/Config.in
```kconfig
config BR2_PACKAGE_PP3_CORE
	bool "pp3-core"
	select BR2_PACKAGE_FREETYPE
	select BR2_PACKAGE_LIBNTAG21X
	select BR2_PACKAGE_LIBNDEF
	select BR2_PACKAGE_NCURSES
	select BR2_PACKAGE_NETCAT
```

## br-external/package/pp3-main/Config.in
```kconfig
config BR2_PACKAGE_PP3_MAIN
	bool "pp3-main"
	select BR2_PACKAGE_LIBNTAG21X
	select BR2_PACKAGE_LIBNDEF
	select BR2_PACKAGE_NCURSES
```

## br-external/package/rpi-eeprom/Config.in
```kconfig
config BR2_PACKAGE_RPI_EEPROM
	bool "rpi-eeprom"
	help
	  Raspberry Pi bootloader tools.

	  https://github.com/raspberrypi/rpi-eeprom
```

## br-external/package/rpi-utils/Config.in
```kconfig
config BR2_PACKAGE_RPI_UTILS
	bool "rpi-utils"
	help
	  A collection of scripts and simple applications for Raspberry Pi.

	  https://github.com/raspberrypi/utils
```

## br2rauc/package/librespot/Config.in
```kconfig
config BR2_PACKAGE_LIBRESPOT
	bool "librespot"
	depends on BR2_PACKAGE_HOST_RUSTC_TARGET_ARCH_SUPPORTS
	select BR2_PACKAGE_HOST_CARGO
        help
	  An open source Spotify client running as a UNIX daemon.
```
